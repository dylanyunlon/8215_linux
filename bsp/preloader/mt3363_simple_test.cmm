SYStem.CPU CORTEXA7MPCore
SYSTEM.OPTION ENRESET OFF
SYS.JC 4.0MHz
wait 10.ms
MULtiCore.COUNT 2
System.up

data.SET 0xF003801C %long 0x1

D.LOAD.Binary .\Preloader\target\3363_Preloader_fpga.bin               0xF4000000
;D.LOAD.Binary B:\3363_bootcode\Preloader\src\test\romdata.bin               		0x0FF80000
;D.LOAD.Binary B:\3363_bootcode\Preloader\src\test\mcusys_default.bin               	0x0FF90000
;D.LOAD.Binary B:\3363_bootcode\Preloader\src\test\mcusys_bitmask.bin               	0x0FFA0000

R.SET PC 0xF4000000

wait 10.ms

;go
enddo