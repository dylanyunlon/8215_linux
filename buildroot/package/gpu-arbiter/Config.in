## source/kernel/kernel-3.18/drivers/misc/atc/Kconfig
```kconfig
comment "ATC Misc config for 3.18 kernel"


menu "ATC Misc config"

menuconfig ATC_SOLUTION
	bool "Autochips Properitary Configuration"
	help
	  Check this to enable Autochips properity configuration.
	  

if ATC_SOLUTION

source "drivers/misc/atc/aee/Kconfig"
source "drivers/misc/atc/boot/Kconfig"
source "drivers/misc/atc/ram_console/Kconfig"
source "drivers/misc/atc/gator-driver/Kconfig"

endif

source "drivers/misc/atc/power-loss-test/Kconfig"

config ATC_LIB_OSAL
	tristate "ATC OS interface Driver"
	default y
	help

	  This is basic driver. If unsure say Y.

config ATC_LIB_BSP
	tristate "ATC BSP interface Driver"
	default y
	help

	  This is basic driver. If unsure say Y.

config ATC_DUAL_ARM
	tristate "ATC Main core and slave core Communication Driver"
	default y
	help

          This is basic driver. If unsure say Y.

config ATC_CPUFREQ
       tristate "ATC CPUfreq driver"
       default m
       help
         This is for cpufreq driver, If unsure say Y.


config ATC_AC8237_BIM
	bool "support ac823x bim Communication Driver"
	default y
	help
	  This is basic driver. If unsure say Y.

config ATC_BOOTPROF
	bool "ATC bootprof driver support"
	default y
	help
	  This is basic driver. If unsure say Y.

config ATC_GPS
	tristate "support atc gps"
	default n
	help
	  This is basic driver. If unsure say Y.

config ATC_CLI
	tristate "support atc cli driver"
	default m
	help
	  This is basic driver. If unsure say Y.

config ATC_CLI_823x
	tristate "support atc cli 823x driver"
	default m
	help
	  This is basic driver. If unsure say Y.

config ATC_METAZONE
	tristate "support atc metazone driver"
	default m
	help
	  This is basic driver. If unsure say Y.

config ATC_GPS_6630
	tristate "support atc gps 6630 driver"
	default n
	help
	  This is basic driver. If unsure say Y.

config ATC_DVP
	tristate "support atc dvp driver"
	default m
	help
	  This is basic driver. If unsure say Y.

config ATC_BKCAR
	tristate "support atc backcar driver"
	default m
	help
	  This is basic driver. If unsure say Y.

config ATC_RAM_CONSOLE
	bool "support atc ram console driver"
	default y
	help
	  This is basic driver. If unsure say Y.

config ATC_AEE_SUPPORT
	bool "support atc aee"
	default y
	help
	  This is basic driver. If unsure say Y.

config ATC_TEE_SUPPORT
	bool "support atc tee"
	default y
	help
	  This is basic driver. If unsure say Y.

config ATC_BASE_POWER
	bool "support atc base power control"
	default n
	help
	  atc power control drivers. 

config ATC_BOOT_STATE
	bool "Enable ATC BOOT STATE Driver"
	default y
	help
	  Show Boot state.
endmenu
```

## source/kernel/kernel-3.18/drivers/misc/atc/aee/Kconfig
```kconfig
config HAVE_AEE_FEATURE
	bool "HAVE_AEE_FEATURE"
	help
	  AEE (Android Exception Engine) that designed by  Mediatek is an
	  exception catching and debugging information generation mechanism.
	  It can collect and dump information to filesystem
	  (/sdcard/mtklog/aee_exp)  when fatel occur(E.g. kernel
	  panic/android system server crash and ..)

config MTK_AEE_FEATURE
	tristate "Enable Android Exception Enhancement"
	default n
	---help---
	  Enable Android Exception Enhancement

config MTK_AEE_AED
	tristate "Enable AEE Kernel Exception Report Daemon"
	default y

config MTK_AEE_IPANIC
	tristate "Enable AEE Kernel Panic Dump"
	default y

config MTK_EMMC_SUPPORT
	bool "MTK_EMMC_SUPPORT"
	default y
	help
	  This enables using embedded Multimedia card (eMMC) as booting 
	  device on MTK platform. Say Y if you turns on MTK_EMMC and want to 
	  use eMMC as booting device. If unsure, say N.
```

## source/kernel/kernel-3.18/drivers/misc/atc/ram_console/Kconfig
```kconfig
config MTK_RAM_CONSOLE
	bool "mt ram console"

config MTK_RAM_CONSOLE_USING_SRAM
	bool "Using SRAM as ram console storage"
	depends on MTK_RAM_CONSOLE

config MTK_RAM_CONSOLE_USING_DRAM
	bool "Using DRAM as ram console storage"
	depends on MTK_RAM_CONSOLE
```
