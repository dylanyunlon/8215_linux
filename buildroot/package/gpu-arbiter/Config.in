## buildroot/package/gpu-arbiter/Config.in
```kconfig
config BR2_PACKAGE_GPU_ARBITER
	bool "gpu-arbiter"
	help
	  Autochips GPU arbiter implementation.
```

## source/kernel/kernel-3.18/arch/arm/configs/ac83xx_defconfig
```kconfig
CONFIG_CROSS_COMPILE="arm-buildroot-linux-gnueabi-"
# CONFIG_LOCALVERSION_AUTO is not set
CONFIG_SYSVIPC=y
CONFIG_POSIX_MQUEUE=y
CONFIG_FHANDLE=y
CONFIG_AUDIT=y
CONFIG_NO_HZ=y
CONFIG_HIGH_RES_TIMERS=y
CONFIG_LOG_BUF_SHIFT=18
CONFIG_CGROUPS=y
CONFIG_CGROUP_DEBUG=y
CONFIG_CGROUP_FREEZER=y
CONFIG_CGROUP_CPUACCT=y
CONFIG_RESOURCE_COUNTERS=y
CONFIG_CGROUP_SCHED=y
# CONFIG_FAIR_GROUP_SCHED is not set
CONFIG_RT_GROUP_SCHED=y
CONFIG_NAMESPACES=y
# CONFIG_UTS_NS is not set
# CONFIG_IPC_NS is not set
# CONFIG_PID_NS is not set
CONFIG_RELAY=y
CONFIG_BLK_DEV_INITRD=y
CONFIG_CC_OPTIMIZE_FOR_SIZE=y
CONFIG_KALLSYMS_ALL=y
CONFIG_EMBEDDED=y
CONFIG_PERF_EVENTS=y
# CONFIG_COMPAT_BRK is not set
CONFIG_JUMP_LABEL=y
CONFIG_MODULES=y
CONFIG_MODULE_UNLOAD=y
# CONFIG_LBDAF is not set
# CONFIG_BLK_DEV_BSG is not set
CONFIG_PARTITION_ADVANCED=y
# CONFIG_IOSCHED_DEADLINE is not set
CONFIG_ARCH_AC83XX=y
CONFIG_MACH_AC83XXFPGA=y
CONFIG_ATC_OS_VER="dizzy"
# CONFIG_VDSO is not set
# CONFIG_CACHE_L2X0 is not set
CONFIG_SMP=y
CONFIG_HAVE_ARM_ARCH_TIMER=y
CONFIG_PREEMPT=y
CONFIG_AEABI=y
CONFIG_HIGHMEM=y
CONFIG_HIGHPTE=y
# CONFIG_CPU_SW_DOMAIN_PAN is not set
# CONFIG_COMPACTION is not set
CONFIG_DEFAULT_MMAP_MIN_ADDR=0
CONFIG_CMA=y
CONFIG_ZSMALLOC=y
CONFIG_PGTABLE_MAPPING=y
CONFIG_ZSMALLOC_STAT=y
CONFIG_MEMBLK_RELEASE_POLICY=y
# CONFIG_ATAGS is not set
CONFIG_KEXEC=y
CONFIG_CRASH_DUMP=y
CONFIG_CPU_FREQ=y
CONFIG_CPU_FREQ_STAT_DETAILS=y
CONFIG_CPU_FREQ_DEFAULT_GOV_USERSPACE=y
CONFIG_CPU_FREQ_GOV_PERFORMANCE=m
CONFIG_CPU_FREQ_GOV_POWERSAVE=m
CONFIG_CPU_FREQ_GOV_ONDEMAND=m
CONFIG_CPU_FREQ_GOV_INTERACTIVE=m
CONFIG_CPU_FREQ_GOV_CONSERVATIVE=m
CONFIG_VFP=y
CONFIG_NEON=y
# CONFIG_CORE_DUMP_DEFAULT_ELF_HEADERS is not set
CONFIG_PM_WAKELOCKS=y
CONFIG_PM_WAKELOCKS_LIMIT=0
CONFIG_PM_RUNTIME=y
CONFIG_PM_DEBUG=y
CONFIG_PM_ADVANCED_DEBUG=y
CONFIG_SUSPEND_TIME=y
CONFIG_NET=y
CONFIG_PACKET=y
CONFIG_UNIX=y
CONFIG_INET=y
CONFIG_IP_MULTICAST=y
CONFIG_IP_ADVANCED_ROUTER=y
CONFIG_IP_MULTIPLE_TABLES=y
# CONFIG_INET_XFRM_MODE_TRANSPORT is not set
# CONFIG_INET_XFRM_MODE_TUNNEL is not set
# CONFIG_INET_XFRM_MODE_BEET is not set
# CONFIG_INET_LRO is not set
CONFIG_IPV6=y
# CONFIG_INET6_XFRM_MODE_TRANSPORT is not set
# CONFIG_INET6_XFRM_MODE_TUNNEL is not set
# CONFIG_INET6_XFRM_MODE_BEET is not set
# CONFIG_IPV6_SIT is not set
# CONFIG_MTK_DHCPV6C_WIFI is not set
# CONFIG_ANDROID_PARANOID_NETWORK is not set
# CONFIG_NET_ACTIVITY_STATS is not set
CONFIG_BRIDGE=y
# CONFIG_BRIDGE_IGMP_SNOOPING is not set
CONFIG_CFG80211=y
CONFIG_NL80211_TESTMODE=y
CONFIG_CFG80211_WEXT=y
CONFIG_MAC80211=y
# CONFIG_MAC80211_RC_MINSTREL is not set
CONFIG_DEVTMPFS=y
CONFIG_DEVTMPFS_MOUNT=y
CONFIG_DMA_CMA=y
CONFIG_CMA_SIZE_MBYTES=8
CONFIG_CONNECTOR=y
CONFIG_MTD=y
CONFIG_MTD_CMDLINE_PARTS=y
CONFIG_MTD_BLOCK=y
CONFIG_MTD_NAND=y
CONFIG_MTD_NAND_ATC=y
CONFIG_NAND_ATC_SW_WP=y
CONFIG_ATC_ATCLIB=y
CONFIG_ZRAM=y
CONFIG_ZRAM_LZ4_COMPRESS=y
CONFIG_ZRAM_DEBUG=y
CONFIG_BLK_DEV_LOOP=y
CONFIG_BLK_DEV_RAM=y
CONFIG_BLK_DEV_RAM_COUNT=1
CONFIG_BLK_DEV_RAM_SIZE=199680
CONFIG_ATC_SOLUTION=y
CONFIG_HAVE_AEE_FEATURE=y
CONFIG_MTK_AEE_FEATURE=y
CONFIG_MTK_RAM_CONSOLE=y
CONFIG_MTK_RAM_CONSOLE_USING_DRAM=y
CONFIG_MTK_RAM_CONSOLE_SIZE=0x40000
CONFIG_MTK_RAM_CONSOLE_ADDR=0xf01000
CONFIG_MTK_RAM_CONSOLE_DRAM_SIZE=0x40000
CONFIG_MTK_RAM_CONSOLE_DRAM_ADDR=0xf01000
CONFIG_PWR_LOSS_ATC_TEST=y
CONFIG_PWR_LOSS_ATC_DEBUG=y
CONFIG_PWR_LOSS_ATC_SPOH=y
# CONFIG_ATC_AC8237_BIM is not set
# CONFIG_ATC_DVP is not set
# CONFIG_ATC_BKCAR is not set
CONFIG_SCSI=y
CONFIG_BLK_DEV_SD=y
CONFIG_CHR_DEV_SG=y
CONFIG_SCSI_LOGGING=y
CONFIG_SCSI_SCAN_ASYNC=y
# CONFIG_SCSI_LOWLEVEL is not set
CONFIG_MD=y
CONFIG_BLK_DEV_DM=y
CONFIG_DM_CRYPT=y
CONFIG_NETDEVICES=y
# CONFIG_ETHERNET is not set
# CONFIG_USB_NET_DRIVERS is not set
CONFIG_HOSTAP=y
CONFIG_HOSTAP_FIRMWARE=y
CONFIG_HOSTAP_FIRMWARE_NVRAM=y
# CONFIG_RTL_CARDS is not set
CONFIG_INPUT_POLLDEV=y
CONFIG_INPUT_EVDEV=y
# CONFIG_INPUT_KEYBOARD is not set
# CONFIG_MOUSE_PS2 is not set
CONFIG_INPUT_TOUCHSCREEN=y
CONFIG_TOUCHSCREEN_GT9XX=m
CONFIG_SERIO_SERPORT=m
CONFIG_VT_HW_CONSOLE_BINDING=y
CONFIG_DEVPTS_MULTIPLE_INSTANCES=y
CONFIG_LEGACY_PTY_COUNT=0
# CONFIG_DEVKMEM is not set
CONFIG_SERIAL_AC83XX=y
CONFIG_SERIAL_AC83XX_CONSOLE=y
CONFIG_HW_RANDOM=y
CONFIG_I2C_CHARDEV=y
# CONFIG_I2C_HELPER_AUTO is not set
CONFIG_I2C_AC83XX=y
# CONFIG_SPI is not set
# CONFIG_SPI_AC83XX is not set
# CONFIG_SPI_SPIDEV is not set
CONFIG_PINCTRL_AC83XX=y
CONFIG_GPIO_SYSFS=y
CONFIG_GPIO_AC83XX=y
CONFIG_GPIO_GENERIC_PLATFORM=y
CONFIG_POWER_SUPPLY=y
# CONFIG_HWMON is not set
CONFIG_WATCHDOG=y
CONFIG_MEDIA_SUPPORT=y
CONFIG_MEDIA_CAMERA_SUPPORT=y
CONFIG_VIDEO_ADV_DEBUG=y
CONFIG_MEDIA_USB_SUPPORT=y
CONFIG_USB_VIDEO_CLASS=y
CONFIG_V4L_PLATFORM_DRIVERS=y
CONFIG_V4L_MEM2MEM_DRIVERS=y
CONFIG_V4L_TEST_DRIVERS=y
CONFIG_ATC_MEDIA_STORAGE_HELPER=y
CONFIG_ATC_USB_SUPPORT_BLACKLIST=y
CONFIG_ATC_MEDIA_SUPPORT_MMISC=y
CONFIG_ATC_MEDIA_SUPPORT_STC=y
CONFIG_ATC_MEDIA_SUPPORT_VDEC=y
CONFIG_ATC_MEDIA_SUPPORT_AUDIO=m
CONFIG_ATC_MEDIA_SUPPORT_IMGRESZ=y
CONFIG_ATC_MEDIA_SUPPORT_JDEC=m
CONFIG_ATC_MEDIA_SUPPORT_PDEC=m
CONFIG_ATC_MEDIA_SUPPORT_GDEC=m
# CONFIG_WCH_ATC is not set
# CONFIG_VIDEO_ATC_CVBS_CAPTURE is not set
CONFIG_MALI400=m
# CONFIG_MALI400_PROFILING is not set
CONFIG_MALI400_UMP=y
# CONFIG_MALI_DVFS is not set
CONFIG_UMP=m
# CONFIG_UMP_DEBUG is not set
CONFIG_FB=y
CONFIG_FIRMWARE_EDID=y
CONFIG_FB_MODE_HELPERS=y
CONFIG_FB_TILEBLITTING=y
CONFIG_ATC_FB_SUPPORT=y
# CONFIG_FB1_ATC is not set
CONFIG_DAL_ATC=y
CONFIG_BACKLIGHT_LCD_SUPPORT=y
# CONFIG_LCD_CLASS_DEVICE is not set
CONFIG_BACKLIGHT_CLASS_DEVICE=y
# CONFIG_BACKLIGHT_GENERIC is not set
CONFIG_SOUND=y
CONFIG_SND=y
CONFIG_SND_MIXER_OSS=y
CONFIG_SND_PCM_OSS=y
# CONFIG_SND_USB is not set
CONFIG_HIDRAW=y
CONFIG_USB=y
CONFIG_USB_ATC_OTG=y
CONFIG_USB_ATC_HDRC_HCD=y
CONFIG_USB_STORAGE=y
CONFIG_NOP_USB_XCEIV=y
CONFIG_USB_GADGET=y
CONFIG_USB_G_ANDROID=y
CONFIG_MMC=y
CONFIG_MMC_BLOCK_MINORS=16
CONFIG_MMC_ATC=y
CONFIG_MSDC_NEW_TUNING_SUPPORT=y
CONFIG_SWITCH=y
CONFIG_RTC_CLASS=y
CONFIG_RTC_DRV_AC83XX=y
CONFIG_STAGING=y
CONFIG_ANDROID=y
CONFIG_ANDROID_BINDER_IPC=y
CONFIG_ASHMEM=y
CONFIG_ANDROID_LOW_MEMORY_KILLER=y
CONFIG_SYNC=y
CONFIG_SW_SYNC=y
CONFIG_SW_SYNC_USER=y
CONFIG_PWM_ATC=y
CONFIG_ATC_BLUETOOTH=m
CONFIG_EXT4_FS=y
CONFIG_AUTOFS4_FS=y
CONFIG_ISO9660_FS=y
CONFIG_MSDOS_FS=y
CONFIG_VFAT_FS=y
CONFIG_FAT_DEFAULT_CODEPAGE=850
CONFIG_NTFS_FS=y
CONFIG_TMPFS=y
CONFIG_TMPFS_POSIX_ACL=y
# CONFIG_MISC_FILESYSTEMS is not set
# CONFIG_NETWORK_FILESYSTEMS is not set
CONFIG_NLS_CODEPAGE_437=y
CONFIG_NLS_CODEPAGE_850=y
CONFIG_NLS_ASCII=y
CONFIG_NLS_ISO8859_1=y
CONFIG_DYNAMIC_DEBUG=y
CONFIG_DEBUG_INFO=y
# CONFIG_ENABLE_WARN_DEPRECATED is not set
# CONFIG_ENABLE_MUST_CHECK is not set
CONFIG_MAGIC_SYSRQ=y
CONFIG_DEBUG_MEMORY_INIT=y
CONFIG_PANIC_ON_OOPS=y
CONFIG_PANIC_TIMEOUT=10
# CONFIG_SCHED_DEBUG is not set
# CONFIG_DEBUG_PREEMPT is not set
CONFIG_STACKTRACE=y
CONFIG_RCU_CPU_STALL_TIMEOUT=60
CONFIG_RCU_CPU_STALL_INFO=y
CONFIG_RCU_TRACE=y
# CONFIG_FTRACE is not set
CONFIG_KEYS=y
CONFIG_SECURITYFS=y
CONFIG_CRYPTO_AUTHENC=y
CONFIG_CRYPTO_HMAC=y
CONFIG_CRYPTO_MD5=y
CONFIG_CRYPTO_SHA1=y
CONFIG_CRYPTO_DES=y
CONFIG_CRYPTO_LZO=y
# CONFIG_CRYPTO_ANSI_CPRNG is not set
# CONFIG_CRYPTO_HW is not set
CONFIG_CRC_CCITT=y
CONFIG_CRC_T10DIF=y
CONFIG_LIBCRC32C=y
```

## source/kernel/kernel-3.18/arch/arm/mach-ac83xx/Kconfig
```kconfig
if ARCH_AC83XX

menu "Autochips AC83XX System-on-Chip"

comment "AC83XX Board Type"

config MACH_AC83XXFPGA
    bool "AC83XX FPGA"
	depends on ARCH_AC83XX
	help
	  select this if you are using V6x2 FPGA board

config MACH_AC83XX
    bool "AC83XX RealChip"
	depends on ARCH_AC83XX
	help
	  select this if you are using AC83XX EVB board

endmenu

config MTK_WIN32_SUPPORT
	int 	
	depends on ARCH_AC83XX
	default 1

config HZ
	int
	depends on ARCH_AC83XX
	default 1000
	
config DVP_RESERVED_MEM
	bool
	default y

config ATC_PLATFORM
	string "ATC platform name"
        default "ac83xx"
        help
          config current platform name

config ATC_OS
	string "ATC OS name"
        default "linux"
        help
          config current project name

config ATC_OS_VER
  string "ATC OS version information"
      default "m"
      help
          config current os version

config ATC_BOARD
	string "ATC board name"
        default "evb"
        help
          config current platform name

config ATC_CUSTOM
  string "ATC Custom"
        default "atc"
        help
            config atc custom information

config ATC_ARCH_CHIP
	string "ATC Chip ID"
        default "ac8317"
        help
          config current project name

endif
```

## source/kernel/kernel-3.18/drivers/btdrv/Kconfig
```kconfig
config ATC_BLUETOOTH
	tristate "support atc btdrv "
	default y
	help
	  This is for btdrv and so on.
```

## source/kernel/kernel-3.18/drivers/clk/atc/Kconfig
```kconfig
#
# ATC SoC drivers
#

config COMMON_CLK_ATC_AC83XX
	bool "Clock driver for ATC AC83XX"
	depends on COMMON_CLK
	select COMMON_CLK_ATC
	default y if ARCH_AC83XX
	---help---
	  This driver supports ATC AC83XX clocks.

config COMMON_CLK_ATC_AC823X
	bool "Clock driver for ATC AC823X"
	depends on COMMON_CLK
	select COMMON_CLK_ATC
	---help---
	  This driver supports ATC AC823X clocks.
```

## source/kernel/kernel-3.18/drivers/media/platform/atc/Kconfig
```kconfig
#
# Platform drivers
#	All media drivers here are currently for atc support

menuconfig ATC_MEDIA_DRIVERS
	bool "Autochips V4L media devices"
	depends on MEDIA_SUPPORT
	default y
	---help---
	  Say Y here to enable support for platform-specific V4L drivers.

if ATC_MEDIA_DRIVERS

#
# Platform multimedia device configuration
#

#source "drivers/media/platform/atc/tvd/Kconfig"

config ATC_MEDIA_STORAGE_HELPER
	bool "storage helper driver"

	help
	  Support for the storage helper.

config ATC_USB_SUPPORT_BLACKLIST
	bool "Not support have none driver USB devices"

	help
	  Not support have none driver USB devices.

config VIDEO_CVBS
	tristate "CVBS_In driver"
	#depends on MEDIA_SUPPORT
	help
	  Support for the cvbs_in on ac83**.

config ATC_MEDIA_SUPPORT_MMISC
	tristate "media misc driver"
	---help---
	  Support for ATC media misc driver. 
	  This device is used for manage the media reserved memory.
	  Say Y here if you want to enable this device.
	  In doubt, say N.
	  
config ATC_MEDIA_SUPPORT_STC
	tristate "stc driver"
	---help---
	  Support for ATC media stc driver. 
	  This device is used for get or set the stc value, 
	  pause or resume stc run.
	  Say Y here if you want to enable this device.
	  In doubt, say N.	  

config ATC_MEDIA_SUPPORT_DEMUXER
	tristate "demuxer driver"
	---help---
	  Support for ATC demuxer driver. 
	  This device splits multimedia data into difference stream,
	  such as video, audio, subtitle, and so on.
	  Say Y here if you want to enable this device.
	  In doubt, say N.

config ATC_MEDIA_SUPPORT_VDEC
	tristate "videodecoder driver"
	---help---
	  Support for ATC video decoder driver. 
	  This device decode various of compressed video bitstream.
	  Say Y here if you want to enable this device.
	  In doubt, say N.	 

config ATC_MEDIA_SUPPORT_AUDIO
	tristate "Audio DEC & ALSA PCM driver"
	---help---
	  Support for ATC Audio Decoder & ALSA PCM driver. 
	  This device decode various of compressed video bitstream.
	  Say Y here if you want to enable this device.
	  In doubt, say N.	 

config ATC_MEDIA_SUPPORT_IMGRESZ
	tristate "Autochips Image Resize Support"
	
config ATC_MEDIA_SUPPORT_IRTDMA
	tristate "Autochips IRTDMA Support"
	default y
config ATC_MEDIA_SUPPORT_GFX
	tristate "Autochips gfx Support"
	default y
config WCH_ATC
       tristate "Autochips Write Channel Support"
       default m

config VCP_ATC
       tristate "Autochips Video Color Process Support"
       default m

config NR_ATC
       tristate "Autochips noise reduce Support"
       default n

config VIDEO_ATC_VOUT
	tristate "ATC V4L2-Display driver"
	select VIDEOBUF_GEN
	select VIDEOBUF_DMA_CONTIG
	default m

config VIDEO_ATC_CVBS_CAPTURE
	tristate "Autochips cvbs video capture driver"
	select VIDEOBUF2_DMA_CONTIG
	select VIDEOBUF2_VMALLOC
	default m
	help
	  Enables Autochips cvbs module used for capture devices.
	  This module is used for capture on AC83**/AC80** SoCs.

	  To compile this driver as a module, choose M here. There will
	  be one module called cvbs.ko

config ATC_MEDIA_SUPPORT_YBRVGA
	tristate "YBRVGA driver"
	---help---
	  Support for ATC ybr vga driver. 
	  This device for ybr vga video in.
	  Say Y here if you want to enable this device.
	  In doubt, say N.

config ATC_MEDIA_SUPPORT_MHL
	tristate "HDMI MHL  driver"
	---help---
	  Support for ATC HDMI MHL driver. 
	  This device for HDMI MHL in.
	  Say Y here if you want to enable this device.
	  In doubt, say N.
config ATC_MEDIA_SUPPORT_HDMI_VOIN
	tristate "HDMI MHL v4l2 driver"
	---help---
	  Support for ATC HDMI MHL v4l2 driver.
	  This device for HDMI MHL in.
	  Say Y here if you want to enable this device.
	  In doubt, say N.

source "drivers/media/platform/atc/mali400/Kconfig"
source "drivers/media/platform/atc/mali_midgard/Kconfig"

endif # ATC_MEDIA_DRIVERS
```

## source/kernel/kernel-3.18/drivers/media/platform/atc/mali_midgard/drivers/Kconfig
```kconfig
source "drivers/media/platform/atc/mali_midgard/drivers/base/Kconfig"
source "drivers/media/platform/atc/mali_midgard/drivers/gpu/Kconfig"
```

## source/kernel/kernel-3.18/drivers/media/platform/atc/mali_midgard/drivers/base/Kconfig
```kconfig
source "drivers/media/platform/atc/mali_midgard/drivers/base/kds/Kconfig"
source "drivers/media/platform/atc/mali_midgard/drivers/base/ump/Kconfig"
```

## source/kernel/kernel-3.18/drivers/media/platform/atc/mhl/ac83xx/Kconfig
```kconfig
config VIDEO_MHL
	tristate "autochips mhl support"
	depends on ATC_MEDIA_SUPPORT_MHL
	---help---
	  This is a video4linux2 driver for the autochips 8317 integrated
	  mhl in.  
```

## source/kernel/kernel-3.18/drivers/media/platform/atc/tvd/ac823x/Kconfig
```kconfig
config VIDEO_TVD
	tristate "autochips tvd support"
	depends on VIDEO_CVBS
	---help---
	  This is a video4linux2 driver for the autochips 8317 integrated
	  cvbs in.  
```

## source/kernel/kernel-3.18/drivers/media/platform/atc/ybr_vga/ac83xx/Kconfig
```kconfig
config VIDEO_YBRVGA
	tristate "autochips ybr support"
	depends on ATC_MEDIA_SUPPORT_YBRVGA
	---help---
	  This is a video4linux2 driver for the autochips 8317 integrated
	  ybrvga in.  
	  
```
