## source/kernel/kernel-3.18/drivers/mtd/nand/atc-nand/Kconfig
```kconfig
config MTD_NAND_ATC
        tristate "Support for ATC 83xx NAND controller"
        help
                Enables support for NAND Flash on ATC SoC based boards.

config NAND_ATC_SW_WP
		bool "ATC NAND software write protect"
		depends on MTD_NAND_ATC != n
		help
		  This is an option for software write protect feature.
```

## source/kernel/kernel-3.18/drivers/net/wireless/aic/Kconfig
```kconfig
# SPDX-License-Identifier: GPL-2.0-only

config WLAN_VENDOR_AIC
	bool "AIC devices"
	default y

if WLAN_VENDOR_AIC
source "drivers/net/wireless/aic/aic8800/Kconfig"
endif
```

## source/kernel/kernel-3.18/drivers/net/wireless/aic/aic8800/Kconfig
```kconfig
# SPDX-License-Identifier: GPL-2.0-only

config ATC_WIFI_CHIP_AIC8800_SDIO
	tristate "ATC_WIFI_CHIP=AIC8800"
	depends on ATC_WIFI_CHIP_SELF_ADAPTIVE || (ATC_WIFI_CHIP="AIC8800" && ATC_WLAN_TRANSMISSION_MODE="SDIO_MODE")
	select ATC_COMBO
	default y

#if ATC_WIFI_CHIP_AIC8800_SDIO
if ATC_WIFI_CHIP_AIC8800_SDIO_n # if 0

config AIC_WLAN_SUPPORT
	bool "AIC wireless Support"
	default n
	help
	  This is support for aic wireless chip.

config AIC_FW_PATH
	depends on AIC_WLAN_SUPPORT
	string "Firmware & config file path"
	default "/vendor/etc/firmware"
	#default "/lib/firmware/aic8800_sdio"
	help
	  Path to the firmware & config file.

source "drivers/net/wireless/aic/aic8800/aic8800_fdrv/Kconfig"
source "drivers/net/wireless/aic/aic8800/aic8800_btlpm/Kconfig"

endif
```

## source/kernel/kernel-3.18/drivers/net/wireless/connectivity/Kconfig
```kconfig
# SPDX-License-Identifier: GPL-2.0-only

config WLAN_VENDOR_ATC
	bool "AIC devices"
	default y

if WLAN_VENDOR_ATC
source "drivers/net/wireless/connectivity/atc_combo/Kconfig"
source "drivers/net/wireless/connectivity/mt6630/Kconfig"
endif
```

## source/kernel/kernel-3.18/drivers/net/wireless/connectivity/atc_combo/Kconfig
```kconfig
# SPDX-License-Identifier: GPL-2.0

config ATC_COMBO
	tristate "ATC_COMBO"
	default n
```

## source/kernel/kernel-3.18/drivers/net/wireless/connectivity/mt6630/Kconfig
```kconfig
# SPDX-License-Identifier: GPL-2.0-only

config ATC_WIFI_CHIP_MT6630_SDIO
	tristate "ATC_WIFI_CHIP=ATC_CHIP_MT6630"
	depends on ATC_WIFI_CHIP_SELF_ADAPTIVE || (ATC_WIFI_CHIP="ATC_CHIP_MT6630" && ATC_WLAN_TRANSMISSION_MODE="SDIO_MODE")
	select ATC_COMBO
	default y
```

## source/kernel/kernel-3.18/drivers/pwm/atc/Kconfig
```kconfig
#
# Autochips pwm configuration
#
config PWM_ATC
       tristate "Autochips PWM Support"
```

## source/kernel/kernel-3.18/drivers/usb/atc/port1/Kconfig
```kconfig
#
# USB Dual Role (OTG-ready) Controller Drivers
# for silicon based on Mentor Graphics INVENTRA designs
#

# (M)HDRC = (Multipoint) Highspeed Dual-Role Controller
#
#

config ATC_MUSBH_QMU_SUPPORT
	bool "QMU Transfer mode of Autochip MUSB"
	default n

config USB_ATC_HCD
	tristate "Autochip MUSB host support"
	default y

config USB_ATC_HDRC_GADGET
	 tristate "Autochip MUSB Gadget support"

config USB_ATC_OTG
	tristate "Autochip MUSB OTG support"

config USB_ATC_DUALMODE
	bool "Autochip DUAL MODE support"
	default n

config USB_ATC_DEBUG
	 tristate "Autochip MUSB Debug support"

config USB_ATC_HDRC_HCD
	 tristate "Autochip USB HDRC support"

config ATC_USB_UNIQUE_SERIAL
	 tristate "Autochip USB unique serial number"

config ATC_USBFSH # USBFSH
	bool "Autochip USB fullspeed Host driver"
	default n

config MUSBFSH_PIO_ONLY
	bool "Transfer mode of Autochip USB fullspeed Host driver"
	default n

config ATC_UART_USB_SWITCH
	bool "ATC_UART_USB_SWITCH"
	help
	  Support share USB DP/DM as UART TX/RX.

# USB # TODO Check Choice
config ATC_USB_GADGET # USB_GADGET_MT6516 USB_GADGET_MT6573
	boolean "Autochip USB Gadget Driver"
	select USB_GADGET_SELECTED
	select USB_GADGET_DUALSPEED
	default y
```

## source/kernel/kernel-3.18/drivers/video/fbdev/atc/Kconfig
```kconfig
#
# Autochips framebuffer configuration
#

#
# Autochips framebuffer configuration
#

menu "ATC FB Select"

menuconfig ATC_FB_SUPPORT
	bool "Autochips fb support"
	help
	  Check this to enable Autochips properity configuration.

if ATC_FB_SUPPORT
config FB0_ATC
       tristate "Autochips Framebuffer Front Support"
       depends on FB
       default m

config FB1_ATC
       tristate "Autochips Framebuffer Rear Support"
       depends on FB
       default n

config PP_ATC
       tristate "Autochips Post Process Support"
       depends on FB
       default n

config DAL_ATC
       tristate "Enable Dal Support"
       depends on FB
       default n
endif 

endmenu
```

## source/vendor/autochips/proprietary/build/configs/Config.in
```kconfig
source "$BR2_EXTERNAL_AC8X_PATH/package/preloader/Config.in"
source "$BR2_EXTERNAL_AC8X_PATH/package/bootloader/Config.in"
source "$BR2_EXTERNAL_AC8X_PATH/package/arm2/Config.in"
source "$BR2_EXTERNAL_AC8X_PATH/package/trustzone/Config.in"
source "$BR2_EXTERNAL_AC8X_PATH/package/mmisc/Config.in"
source "$BR2_EXTERNAL_AC8X_PATH/package/libmetazone/Config.in"
source "$BR2_EXTERNAL_AC8X_PATH/package/atcomx/Config.in"
source "$BR2_EXTERNAL_AC8X_PATH/package/atccodec/Config.in"
source "$BR2_EXTERNAL_AC8X_PATH/package/directrender/Config.in"
source "$BR2_EXTERNAL_AC8X_PATH/package/atcmultimedia/Config.in"
source "$BR2_EXTERNAL_AC8X_PATH/package/atcmediaplayer/Config.in"
source "$BR2_EXTERNAL_AC8X_PATH/package/libatcsurface/Config.in"
source "$BR2_EXTERNAL_AC8X_PATH/package/mountservice/Config.in"
source "$BR2_EXTERNAL_AC8X_PATH/package/fsck_msdos/Config.in"
source "$BR2_EXTERNAL_AC8X_PATH/package/libimgresz/Config.in"
source "$BR2_EXTERNAL_AC8X_PATH/package/vba/Config.in"
source "$BR2_EXTERNAL_AC8X_PATH/package/mali-t400/Config.in"
source "$BR2_EXTERNAL_AC8X_PATH/package/egl_test/Config.in"
source "$BR2_EXTERNAL_AC8X_PATH/package/update/Config.in"
source "$BR2_EXTERNAL_AC8X_PATH/package/atcupdatetest/Config.in"
source "$BR2_EXTERNAL_AC8X_PATH/package/libupdate/Config.in"
source "$BR2_EXTERNAL_AC8X_PATH/package/aee_service//Config.in"
source "$BR2_EXTERNAL_AC8X_PATH/package/libsettings_atc/Config.in"
source "$BR2_EXTERNAL_AC8X_PATH/package/pq_test/Config.in"
source "$BR2_EXTERNAL_AC8X_PATH/package/qt_test/Config.in"
source "$BR2_EXTERNAL_AC8X_PATH/package/lvds_test/Config.in"
source "$BR2_EXTERNAL_AC8X_PATH/package/universal_utils/Config.in"
source "$BR2_EXTERNAL_AC8X_PATH/package/policyaux/Config.in"
source "$BR2_EXTERNAL_AC8X_PATH/package/btspeech/Config.in"
source "$BR2_EXTERNAL_AC8X_PATH/package/bluecommon/Config.in"
source "$BR2_EXTERNAL_AC8X_PATH/package/blueclient/Config.in"
source "$BR2_EXTERNAL_AC8X_PATH/package/blueserver/Config.in"
source "$BR2_EXTERNAL_AC8X_PATH/package/bluestack/Config.in"
source "$BR2_EXTERNAL_AC8X_PATH/package/connectivity/Config.in"
source "$BR2_EXTERNAL_AC8X_PATH/package/cluster-app/Config.in"
source "$BR2_EXTERNAL_AC8X_PATH/package/cluster-cli/Config.in"
source "$BR2_EXTERNAL_AC8X_PATH/package/cluster-service/Config.in"
source "$BR2_EXTERNAL_AC8X_PATH/package/application/apputils/Config.in"
source "$BR2_EXTERNAL_AC8X_PATH/package/application/appcommon/Config.in"
source "$BR2_EXTERNAL_AC8X_PATH/package/application/appobj/Config.in"
source "$BR2_EXTERNAL_AC8X_PATH/package/application/globalbus/Config.in"
source "$BR2_EXTERNAL_AC8X_PATH/package/application/appmanager/Config.in"
source "$BR2_EXTERNAL_AC8X_PATH/package/application/mainapplication/Config.in"
source "$BR2_EXTERNAL_AC8X_PATH/package/application/home/Config.in"
source "$BR2_EXTERNAL_AC8X_PATH/package/application/btpts_tool/Config.in"
source "$BR2_EXTERNAL_AC8X_PATH/package/application/btapp/Config.in"
source "$BR2_EXTERNAL_AC8X_PATH/package/application/carplayapp/Config.in"
source "$BR2_EXTERNAL_AC8X_PATH/package/application/dvrapp/Config.in"
source "$BR2_EXTERNAL_AC8X_PATH/package/application/androidautoapp/Config.in"
source "$BR2_EXTERNAL_AC8X_PATH/package/test/Config.in"
source "$BR2_EXTERNAL_AC8X_PATH/package/cluster-qd/Config.in"
source "$BR2_EXTERNAL_AC8X_PATH/package/awtk/Config.in"
source "$BR2_EXTERNAL_AC8X_PATH/package/application/carbitapp/Config.in"
source "$BR2_EXTERNAL_AC8X_PATH/package/libidc/Config.in"
source "$BR2_EXTERNAL_AC8X_PATH/package/stressapptest/Config.in"
source "$BR2_EXTERNAL_AC8X_PATH/package/libidcclientmanager/Config.in"
source "$BR2_EXTERNAL_AC8X_PATH/package/libdvr/Config.in"
source "$BR2_EXTERNAL_AC8X_PATH/package/atcmediascanner/Config.in"
source "$BR2_EXTERNAL_AC8X_PATH/package/libbzip2/Config.in"
source "$BR2_EXTERNAL_AC8X_PATH/package/recovery/Config.in"
source "$BR2_EXTERNAL_AC8X_PATH/package/libminizip/Config.in"
source "$BR2_EXTERNAL_AC8X_PATH/package/storage_utils/Config.in"
```

## source/vendor/autochips/proprietary/build/configs/configs/ac83xx_defconfig
```kconfig
BR2_PRIMARY_SITE=""
BR2_BACKUP_SITE=""
BR2_KERNEL_MIRROR=""
BR2_GNU_MIRROR=""
BR2_LUAROCKS_MIRROR=""
BR2_CPAN_MIRROR=""
BR2_aarch64=n
BR2_arm=y
BR2_KERNEL_HEADERS_3_18=y
BR2_TOOLCHAIN_BUILDROOT_GLIBC=y
BR2_TOOLCHAIN_BUILDROOT_CXX=y
BR2_TARGET_GENERIC_HOSTNAME="Linux"
BR2_TARGET_GENERIC_ISSUE="Welcome to Linux"
BR2_INIT_SYSV=y
BR2_TARGET_GENERIC_ROOT_PASSWD="root"
BR2_SYSTEM_BIN_SH_BASH=y
BR2_ROOTFS_POST_BUILD_SCRIPT="$(BR2_EXTERNAL)/board/autochips/common/post-build.sh"
BR2_ROOTFS_POST_IMAGE_SCRIPT="$(BR2_EXTERNAL)/board/autochips/common/post-image.sh"
BR2_LINUX_KERNEL=y
BR2_LINUX_KERNEL_CUSTOM_LOCAL=y
BR2_LINUX_KERNEL_CUSTOM_LOCAL_PATH="$(TOPDIR)/../source/kernel/kernel-3.18"
BR2_LINUX_KERNEL_DEFCONFIG="ac83xx"
BR2_LINUX_KERNEL_DTS_SUPPORT=y
BR2_LINUX_KERNEL_INTREE_DTS_NAME="ac83xx"
BR2_LINUX_KERNEL_PER_SCRIPT=y
BR2_PACKAGE_ALSA_LIB=y
BR2_PACKAGE_ALSA_UTILS=y
BR2_PACKAGE_ALSA_UTILS_ALSACONF=y
BR2_PACKAGE_ALSA_UTILS_ACONNECT=y
BR2_PACKAGE_ALSA_UTILS_ALSALOOP=y
BR2_PACKAGE_ALSA_UTILS_ALSAUCM=y
BR2_PACKAGE_ALSA_UTILS_ALSATPLG=y
BR2_PACKAGE_ALSA_UTILS_AMIDI=y
BR2_PACKAGE_ALSA_UTILS_AMIXER=y
BR2_PACKAGE_ALSA_UTILS_APLAY=y
BR2_PACKAGE_ALSA_UTILS_APLAYMIDI=y
BR2_PACKAGE_ALSA_UTILS_ARECORDMIDI=y
BR2_PACKAGE_ALSA_UTILS_ASEQDUMP=y
BR2_PACKAGE_ALSA_UTILS_ASEQNET=y
BR2_PACKAGE_ALSA_UTILS_BAT=y
BR2_PACKAGE_ALSA_UTILS_IECSET=y
BR2_PACKAGE_ALSA_UTILS_SPEAKER_TEST=y
BR2_PACKAGE_LIBGLIB2=y
BR2_PACKAGE_STRACE=y
BR2_PACKAGE_E2FSPROGS=y
BR2_PACKAGE_OPENSSL=y
BR2_PACKAGE_LIBDRM_INSTALL_TESTS=y
BR2_PACKAGE_DTC=y
BR2_PACKAGE_LIBAIO=y
BR2_PACKAGE_YAJL=y
BR2_PACKAGE_PCRE2=y
BR2_PACKAGE_PCRE2_16=y
BR2_TARGET_ROOTFS_EXT4=y
BR2_TARGET_ROOTFS_EXT4_LABEL="system"
BR2_TARGET_ROOTFS_EXT4_SIZE="200M"
BR2_TARGET_ROOTFS_EXT4_MKFS_OPTIONS=""
BR2_PACKAGE_ANDROID_TOOLS=y
BR2_PACKAGE_ANDROID_TOOLS_ADBD=y
# BR2_TARGET_ROOTFS_TAR is not set
BR2_PACKAGE_PRELOADER=y
BR2_PACKAGE_BOOTLOADER=y
BR2_PACKAGE_ARM2=y
BR2_PACKAGE_TRUSTZONE=y
BR2_PACKAGE_DBUS=y
BR2_PACKAGE_LIBMETAZONE=y
BR2_PACKAGE_MMISC=y
BR2_PACKAGE_ATCOMX=y
BR2_PACKAGE_ATCCODEC=y
BR2_PACKAGE_DIRECTRENDER=y
BR2_PACKAGE_ATCMULTIMEDIA=y
BR2_PACKAGE_ATCMEDIAPLAYER=y
BR2_PACKAGE_ATCMEDIASCANNER=y
BR2_PACKAGE_LIBATCSURFACE=y
BR2_PACKAGE_MOUNTSERVICE=y
BR2_PACKAGE_FSCK_MSDOS=y
BR2_PACKAGE_LIBIMGRESZ=y
BR2_PACKAGE_VBA=y
BR2_PACKAGE_MALI_T400=y
BR2_PACKAGE_UPDATE=y
BR2_PACKAGE_LIBUPDATE=y
BR2_PACKAGE_ATCUPDATETEST=y
BR2_PACKAGE_TINYXML2=y
BR2_PACKAGE_AEE_SERVICE=y
BR2_PACKAGE_LIBSETTINGS_ATC=y
BR2_PACKAGE_PQ_TEST=y
BR2_PACKAGE_LVDS_TEST=y
BR2_PACKAGE_POLICYAUX=y
BR2_PACKAGE_BTSPEECH=y
BR2_PACKAGE_TEST=y
BR2_PACKAGE_STRESSAPPTEST=y
BR2_PACKAGE_LIBBZIP2=y
BR2_PACKAGE_RECOVERY=y
BR2_PACKAGE_LIBMINIZIP=y
BR2_PACKAGE_STORAGE_UTILS=y
```

## source/vendor/autochips/proprietary/build/configs/package/aee_service/Config.in
```kconfig
config BR2_PACKAGE_AEE_SERVICE
	bool "aee_service"
	help
	  this is a aee-service for dump NE and KE Information.
```

## source/vendor/autochips/proprietary/build/configs/package/application/androidautoapp/Config.in
```kconfig
config BR2_PACKAGE_ANDROIDAUTOAPP
	bool "androidautoapp"
	select BR2_PACKAGE_QT5BASE
	select BR2_PACKAGE_QT5BASE_GUI
	select BR2_PACKAGE_QT5DECLARATIVE
	select BR2_PACKAGE_QT5DECLARATIVE_QUICK
	select BR2_PACKAGE_UNIVERSAL_UTILS
	select BR2_PACKAGE_APPUTILS
	select BR2_PACKAGE_GLOBALBUS
	select BR2_PACKAGE_APPCOMMON
	select BR2_PACKAGE_ANDROIDAUTO
	help
    this is a qt androidautoapp
```

## source/vendor/autochips/proprietary/build/configs/package/application/appcommon/Config.in
```kconfig
config BR2_PACKAGE_APPCOMMON
  bool "appcommon"
  select BR2_PACKAGE_QT5BASE
  select BR2_PACKAGE_QT5BASE_GUI
  select BR2_PACKAGE_QT5DECLARATIVE
	select BR2_PACKAGE_QT5DECLARATIVE_QUICK
  help
    this is a qt appcommon lib
```

## source/vendor/autochips/proprietary/build/configs/package/application/appmanager/Config.in
```kconfig
config BR2_PACKAGE_APPMANAGER
  bool "appmanager"
  select BR2_PACKAGE_QT5BASE
  select BR2_PACKAGE_QT5BASE_GUI
  select BR2_PACKAGE_TINYXML2
  select BR2_PACKAGE_UNIVERSAL_UTILS
  select BR2_PACKAGE_APPUTILS
  select BR2_PACKAGE_GLOBALBUS
  help
    this is a qt appmanager
```

## source/vendor/autochips/proprietary/build/configs/package/application/appobj/Config.in
```kconfig
config BR2_PACKAGE_APPOBJ
  bool "appobj"
  select BR2_PACKAGE_QT5BASE
  select BR2_PACKAGE_QT5BASE_GUI
  select BR2_PACKAGE_UNIVERSAL_UTILS
  select BR2_PACKAGE_APPUTILS
  help
    this is a qt appobj lib
```

## source/vendor/autochips/proprietary/build/configs/package/application/apputils/Config.in
```kconfig
config BR2_PACKAGE_APPUTILS
  bool "apputils"
  select BR2_PACKAGE_QT5BASE
  select BR2_PACKAGE_QT5BASE_GUI
  select BR2_PACKAGE_UNIVERSAL_UTILS
  help
    this is a qt apputils lib
```

## source/vendor/autochips/proprietary/build/configs/package/application/btapp/Config.in
```kconfig
config BR2_PACKAGE_BTAPP
	bool "btapp"
	select BR2_PACKAGE_QT5BASE
	select BR2_PACKAGE_QT5BASE_GUI
	select BR2_PACKAGE_TINYXML2
	select BR2_PACKAGE_BLUECOMMON
	select BR2_PACKAGE_BLUECLIENT
	select BR2_PACKAGE_UNIVERSAL_UTILS
	select BR2_PACKAGE_QT5DECLARATIVE
	select BR2_PACKAGE_QT5DECLARATIVE_QUICK

	help
	  this is a btapp
```

## source/vendor/autochips/proprietary/build/configs/package/application/btphone/Config.in
```kconfig
config BR2_PACKAGE_BTPHONE
	bool "btphone"
	select BR2_PACKAGE_QT5BASE
	select BR2_PACKAGE_QT5BASE_GUI
	select BR2_PACKAGE_QT5DECLARATIVE
	select BR2_PACKAGE_QT5DECLARATIVE_QUICK

	help
	  this is a btphone
```

## source/vendor/autochips/proprietary/build/configs/package/application/btpts_tool/Config.in
```kconfig
config BR2_PACKAGE_BTPTS_TOOL
	bool "btpts_tool"
	select BR2_PACKAGE_QT5BASE
	select BR2_PACKAGE_QT5BASE_GUI
	select BR2_PACKAGE_TINYXML2
	select BR2_PACKAGE_BLUECOMMON
	select BR2_PACKAGE_BLUECLIENT
	select BR2_PACKAGE_UNIVERSAL_UTILS

	help
	  this is a btpts_tool
```

## source/vendor/autochips/proprietary/build/configs/package/application/carbitapp/Config.in
```kconfig
config BR2_PACKAGE_CARBITAPP
  bool "carbitapp"
  select BR2_PACKAGE_QT5BASE
  select BR2_PACKAGE_QT5BASE_GUI
  select BR2_PACKAGE_QT5DECLARATIVE
  select BR2_PACKAGE_QT5DECLARATIVE_QUICK
  select BR2_PACKAGE_UNIVERSAL_UTILS
  select BR2_PACKAGE_APPUTILS
  select BR2_PACKAGE_GLOBALBUS
  select BR2_PACKAGE_APPCOMMON
  help
    this is a qt carbitapp
```

## source/vendor/autochips/proprietary/build/configs/package/application/dvrapp/Config.in
```kconfig
config BR2_PACKAGE_DVRAPP
	bool "dvrapp"
	select BR2_PACKAGE_QT5BASE
	select BR2_PACKAGE_QT5BASE_GUI
	select BR2_PACKAGE_TINYXML2
	select BR2_PACKAGE_UNIVERSAL_UTILS
	select BR2_PACKAGE_QT5DECLARATIVE
	select BR2_PACKAGE_QT5DECLARATIVE_QUICK
	select BR2_PACKAGE_LIBDVR
	select BR2_PACKAGE_APPOBJ
	select BR2_PACKAGE_APPCOMMON
	select BR2_PACKAGE_APPUTILS
	select BR2_PACKAGE_GLOBALBUS

	help
	  this is a dvr app
```

## source/vendor/autochips/proprietary/build/configs/package/application/globalbus/Config.in
```kconfig
config BR2_PACKAGE_GLOBALBUS
  bool "globalbus"
  select BR2_PACKAGE_QT5BASE
  select BR2_PACKAGE_QT5BASE_GUI
  select BR2_PACKAGE_UNIVERSAL_UTILS
  select BR2_PACKAGE_APPUTILS
  help
    this is a qt appglobalbus lib
```
