## source/vendor/autochips/proprietary/build/configs/package/application/mainapplication/Config.in
```kconfig
config BR2_PACKAGE_MAINAPPLICATION
  bool "mainapplication"
  select BR2_PACKAGE_QT5BASE
  select BR2_PACKAGE_QT5BASE_GUI
  select BR2_PACKAGE_UNIVERSAL_UTILS
  select BR2_PACKAGE_APPUTILS
  select BR2_PACKAGE_GLOBALBUS
  help
    this is a qt mainapplication
```
