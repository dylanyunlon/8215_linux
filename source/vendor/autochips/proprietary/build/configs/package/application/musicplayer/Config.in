## source/vendor/autochips/proprietary/build/configs/package/application/musicplayer/Config.in
```kconfig
config BR2_PACKAGE_MUSICPLAYER
	bool "musicplayer"
	select BR2_PACKAGE_FFMPEG
	select BR2_PACKAGE_ALSA_LIB
	help
	  Local music player service with ID3 tag parsing
	  and playlist management. Hardware decode via
	  libatcmediaplayer with FFmpeg+ALSA software fallback.
```

## source/vendor/autochips/proprietary/build/configs/package/application/musicplayer_awtk/Config.in
```kconfig
config BR2_PACKAGE_MUSICPLAYER_AWTK
	bool "musicplayer_awtk"
	depends on BR2_PACKAGE_AWTK
	depends on BR2_PACKAGE_MUSICPLAYER
	help
	  AWTK 本地音乐播放器应用。
	  提供触摸 UI 界面，支持 USB/SD 音乐文件扫描、播放、
	  收藏管理、歌词显示、专辑封面等功能。

	  编译输出: /usr/bin/music_player
```

## source/vendor/autochips/proprietary/build/configs/package/atccodec/Config.in
```kconfig
config BR2_PACKAGE_ATCCODEC
	bool "atccodec"
	help
	  Autochips atccodec components.
```

## source/vendor/autochips/proprietary/build/configs/package/atcmediaplayer/Config.in
```kconfig
config BR2_PACKAGE_ATCMEDIAPLAYER
	bool "atcmediaplayer"
	help
	  Autochips atcmediaplayer components.
```

## source/vendor/autochips/proprietary/build/configs/package/atcmediascanner/Config.in
```kconfig
config BR2_PACKAGE_ATCMEDIASCANNER
	depends on BR2_PACKAGE_ATCMULTIMEDIA
	depends on BR2_PACKAGE_MMISC
	bool "atcmediascanner"
	help
	  Autochips atcmediascanner.
```

## source/vendor/autochips/proprietary/build/configs/package/atcmultimedia/Config.in
```kconfig
config BR2_PACKAGE_ATCMULTIMEDIA
	bool "atcmultimedia"
	help
	  Autochips atcmultimedia components.
```

## source/vendor/autochips/proprietary/build/configs/package/atcupdatetest/Config.in
```kconfig
config BR2_PACKAGE_ATCUPDATETEST
	bool "updatetest library"
	help
	  Autochips updatetest library
```

## source/vendor/autochips/proprietary/build/configs/package/bluecommon/Config.in
```kconfig
config BR2_PACKAGE_BLUECOMMON
	select BR2_PACKAGE_SQLITE
	select BR2_PACKAGE_TINYXML2
	select BR2_PACKAGE_PROTOBUF

	bool "bluecommon"
	help
	  this is a bluecommon
```

## source/vendor/autochips/proprietary/build/configs/package/blueserver/Config.in
```kconfig
config BR2_PACKAGE_BLUESERVER
	select BR2_PACKAGE_LIBNL
	select BR2_PACKAGE_TINYXML2

	bool "blueserver"
	help
	  this is a blueserver
```

## source/vendor/autochips/proprietary/build/configs/package/bluestack/Config.in
```kconfig
config BR2_PACKAGE_BLUESTACK
	select BR2_PACKAGE_LIBMETAZONE
	select BR2_PACKAGE_ZLIB
	bool "bluestack"
	help
	  this is a bluestack
```

## source/vendor/autochips/proprietary/build/configs/package/btspeech/Config.in
```kconfig
config BR2_PACKAGE_BTSPEECH
	bool "btspeech"
	select BR2_PACKAGE_ALSA_LIB
	help
	  Autochips audio btspeech.
```

## source/vendor/autochips/proprietary/build/configs/package/buf_allocator/Config.in
```kconfig
config BR2_PACKAGE_BUF_ALLOCATOR
	bool "libbuf_allocator"
	help
	  this is a buf allocator so
```

## source/vendor/autochips/proprietary/build/configs/package/camera/Config.in
```kconfig
config BR2_PACKAGE_CAMERA
	bool "autochips avm"
	select BR2_PACKAGE_LIBAVM
	help
	  this is a avm application
```

## source/vendor/autochips/proprietary/build/configs/package/camerasource/Config.in
```kconfig
config BR2_PACKAGE_CAMERASOURCE
	bool "libcamerasource"
	depends on BR2_PACKAGE_BUF_ALLOCATOR
	help
	  this is a camera source so
```

## source/vendor/autochips/proprietary/build/configs/package/cluster-cli/Config.in
```kconfig
config BR2_PACKAGE_CLUSTER_CLI
	bool "cluster-cli"
	help
	  this is a cluster-cli
```

## source/vendor/autochips/proprietary/build/configs/package/cluster-daemon/Config.in
```kconfig
config BR2_PACKAGE_CLUSTER_DAEMON
	bool "cluster-daemon"
	help
	  this is a cluster-daemon
```

## source/vendor/autochips/proprietary/build/configs/package/cluster-qd/Config.in
```kconfig
config BR2_PACKAGE_CLUSTER_QD
	bool "cluster-qd"
	help
		this is a qd cluster-demo
```

## source/vendor/autochips/proprietary/build/configs/package/cluster-service/Config.in
```kconfig
config BR2_PACKAGE_CLUSTER_SERVICE
	bool "cluster-service"
	help
	  this is a cluster-service
```

## source/vendor/autochips/proprietary/build/configs/package/connectivity/Config.in
```kconfig
source "$BR2_EXTERNAL_AC8X_PATH/package/connectivity/wifi/Config.in"
source "$BR2_EXTERNAL_AC8X_PATH/package/connectivity/carlink/Config.in"
```

## source/vendor/autochips/proprietary/build/configs/package/connectivity/carlink/Config.in
```kconfig
source "$BR2_EXTERNAL_AC8X_PATH/package/connectivity/carlink/carplay/Config.in"
source "$BR2_EXTERNAL_AC8X_PATH/package/connectivity/carlink/carbit/Config.in"
source "$BR2_EXTERNAL_AC8X_PATH/package/connectivity/carlink/androidauto/Config.in"
```
