## source/vendor/autochips/proprietary/build/configs/package/connectivity/carlink/androidauto/Config.in
```kconfig
config BR2_PACKAGE_ANDROIDAUTO
    bool "androidauto package group"
    select BR2_PACKAGE_OPENSSLPREBUILT
    select BR2_PACKAGE_CARLINKCONFIGS
    select BR2_PACKAGE_CARLINKUTILS
    select BR2_PACKAGE_BOOST
    select BR2_PACKAGE_TINYXML2
    select BR2_PACKAGE_LIBUSB
    select BR2_PACKAGE_ANDROIDAUTO_MODULE
    help
        androidauto package group.

if BR2_PACKAGE_ANDROIDAUTO
    source "$BR2_EXTERNAL_AC8X_PATH/package/connectivity/carlink/androidauto/opensslprebuilt/Config.in"
endif
```

## source/vendor/autochips/proprietary/build/configs/package/connectivity/carlink/androidauto/androidauto/Config.in
```kconfig
config BR2_PACKAGE_ANDROIDAUTO_MODULE
    bool "androidauto module"
    select BR2_PACKAGE_PROTOBUF
    select BR2_PACKAGE_OPENSSL_PREBUILT
    select BR2_PACKAGE_BOOST
    help
        AndroidAuto module.
```

## source/vendor/autochips/proprietary/build/configs/package/connectivity/carlink/androidauto/opensslprebuilt/Config.in
```kconfig
config BR2_PACKAGE_OPENSSLPREBUILT
    bool "opensslprebuilt"
    help
      OpenSSL 1.1.1g prebuilt library for Android Auto
```

## source/vendor/autochips/proprietary/build/configs/package/connectivity/carlink/carbit/Config.in
```kconfig
config BR2_PACKAGE_CARBIT
  bool "carbit"
  select BR2_PACKAGE_CARBITAPP
  help
    this is carbit dependency
```

## source/vendor/autochips/proprietary/build/configs/package/connectivity/carlink/carplay/Config.in
```kconfig
source "$BR2_EXTERNAL_AC8X_PATH/package/connectivity/carlink/carplay/carplay/Config.in"
```

## source/vendor/autochips/proprietary/build/configs/package/connectivity/carlink/carplay/appleplugin/Config.in
```kconfig
config BR2_PACKAGE_APPLEPLUGIN
	bool "appleplugin component"
	select BR2_PACKAGE_CARLINKCONFIGS
	select BR2_PACKAGE_MDNSRESPONDER
	help
		libcoreutils, libcarplayplugin.
```

## source/vendor/autochips/proprietary/build/configs/package/connectivity/carlink/carplay/carlinkconfigs/Config.in
```kconfig
config BR2_PACKAGE_CARLINKCONFIGS
	bool "carlinkconfigs compoent"
	select BR2_PACKAGE_UNIVERSAL_UTILS
	select BR2_PACKAGE_LIBMETAZONE
	select BR2_PACKAGE_CARPLAYTESTS
	select BR2_PACKAGE_WIFI
	select BR2_PACKAGE_BLUECOMMON
	select BR2_PACKAGE_BLUECLIENT
	help
		libaccessoryinfo, libMFICoprocessor and CarPlay/AndroidAuto's xml.
```

## source/vendor/autochips/proprietary/build/configs/package/connectivity/carlink/carplay/carlinkmanager/Config.in
```kconfig
config BR2_PACKAGE_CARLINKMANAGER
	bool "carlinkmanager component"
	select BR2_PACKAGE_IAP
	select BR2_PACKAGE_LIBCONFIG
	help
		libcarlinkclient, libusbg, libcarlinkimpl, carlinkmanager.
```

## source/vendor/autochips/proprietary/build/configs/package/connectivity/carlink/carplay/carlinkutils/Config.in
```kconfig
config BR2_PACKAGE_CARLINKUTILS
	bool "carlinkutils component"
	select BR2_PACKAGE_PROTOBUF
	select BR2_PACKAGE_TINYXML2
	select BR2_PACKAGE_FDK_AAC
	select BR2_PACKAGE_OPUS
	select BR2_PACKAGE_UNIVERSAL_UTILS
	help
		libcarlinkutils, libaacdec, libopus.
```

## source/vendor/autochips/proprietary/build/configs/package/connectivity/carlink/carplay/carplay/Config.in
```kconfig
config BR2_PACKAGE_CARPLAY
	bool "carplay package group"
	select BR2_PACKAGE_CARLINKCONFIGS
	select BR2_PACKAGE_CARLINKUTILS
	select BR2_PACKAGE_MDNSRESPONDER
	select BR2_PACKAGE_APPLEPLUGIN
	select BR2_PACKAGE_CARPLAYTESTS
	select BR2_PACKAGE_IAP
	select BR2_PACKAGE_CARLINKMANAGER
	select BR2_PACKAGE_CARPLAYPLUGIN
	select BR2_PACKAGE_CARPLAYSERVICE
	select BR2_PACKAGE_CARPLAYMANAGER
	select BR2_PACKAGE_IPERF
	help
		carplay package group.

if BR2_PACKAGE_CARPLAY
	source "$BR2_EXTERNAL_AC8X_PATH/package/connectivity/carlink/carplay/carlinkconfigs/Config.in"
	source "$BR2_EXTERNAL_AC8X_PATH/package/connectivity/carlink/carplay/carlinkutils/Config.in"
	source "$BR2_EXTERNAL_AC8X_PATH/package/connectivity/carlink/carplay/mdnsresponder/Config.in"
	source "$BR2_EXTERNAL_AC8X_PATH/package/connectivity/carlink/carplay/appleplugin/Config.in"
	source "$BR2_EXTERNAL_AC8X_PATH/package/connectivity/carlink/carplay/carplaytests/Config.in"
	source "$BR2_EXTERNAL_AC8X_PATH/package/connectivity/carlink/carplay/iap/Config.in"
	source "$BR2_EXTERNAL_AC8X_PATH/package/connectivity/carlink/carplay/carlinkmanager/Config.in"
	source "$BR2_EXTERNAL_AC8X_PATH/package/connectivity/carlink/carplay/carplayplugin/Config.in"
	source "$BR2_EXTERNAL_AC8X_PATH/package/connectivity/carlink/carplay/carplayservice/Config.in"
	source "$BR2_EXTERNAL_AC8X_PATH/package/connectivity/carlink/carplay/carplaymanager/Config.in"
endif
```

## source/vendor/autochips/proprietary/build/configs/package/connectivity/carlink/carplay/carplaymanager/Config.in
```kconfig
config BR2_PACKAGE_CARPLAYMANAGER
	bool "carplaymanager component"
	select BR2_PACKAGE_CARPLAYSERVICE
	help
		carplaymanagerservice.
```

## source/vendor/autochips/proprietary/build/configs/package/connectivity/carlink/carplay/carplayplugin/Config.in
```kconfig
config BR2_PACKAGE_CARPLAYPLUGIN
	bool "carplayplugin component"
	select BR2_PACKAGE_APPLEPLUGIN
	select BR2_PACKAGE_IAP
	select BR2_PACKAGE_LIBATCSURFACE
	help
		libcarplaypluginclient, libcarplayplugincommon, libcarplay_av_core, libcarplay_plugin_impl, libcarplayhid,
		libaudiostream, libscreenstream, libaudioconverter, carplaypluginservice.
```

## source/vendor/autochips/proprietary/build/configs/package/connectivity/carlink/carplay/carplayservice/Config.in
```kconfig
config BR2_PACKAGE_CARPLAYSERVICE
	bool "carplayservice component"
	select BR2_PACKAGE_IAP
	select BR2_PACKAGE_CARLINKMANAGER
	select BR2_PACKAGE_CARPLAYPLUGIN
	help
		libcarplaycommon, libcarplayclient, carplayservice.
```

## source/vendor/autochips/proprietary/build/configs/package/connectivity/carlink/carplay/carplaytests/Config.in
```kconfig
config BR2_PACKAGE_CARPLAYTESTS
	bool "accessory interfaces"
	help
		accessory interfaces.
```

## source/vendor/autochips/proprietary/build/configs/package/connectivity/carlink/carplay/iap/Config.in
```kconfig
config BR2_PACKAGE_IAP
	bool "iap component"
	select BR2_PACKAGE_CARLINKCONFIGS
	select BR2_PACKAGE_CARLINKUTILS
	help
		libiapclient, libiapimpl, iap.
```

## source/vendor/autochips/proprietary/build/configs/package/connectivity/carlink/carplay/mdnsresponder/Config.in
```kconfig
config BR2_PACKAGE_MDNSRESPONDER
	bool "mdnsresponder component"
	help
		libmdnssd, mdnsd.
```

## source/vendor/autochips/proprietary/build/configs/package/connectivity/wifi/connman/Config.in
```kconfig
config BR2_PACKAGE_CONNMAN
	bool "connman"
	select BR2_PACKAGE_DBUS
	select BR2_PACKAGE_LIBGLIB2
	select BR2_PACKAGE_READLINE
	select BR2_PACKAGE_IPTABLES
	help
	  connman
```

## source/vendor/autochips/proprietary/build/configs/package/connectivity/wifi/dbus-cpp/Config.in
```kconfig
config BR2_PACKAGE_DBUS_CPP
	bool "dbus-c++"
	select BR2_PACKAGE_DBUS
	help
	  dbus-c++
```

## source/vendor/autochips/proprietary/build/configs/package/connectivity/wifi/wifi-private/Config.in
```kconfig
config BR2_PACKAGE_WIFI_PRIVATE
	bool "wifi-private"
	select BR2_PACKAGE_UNIVERSAL_UTILS
	select BR2_PACKAGE_DBUS_CPP
	select BR2_PACKAGE_METAZONE
	select BR2_PACKAGE_TINYXML2
	select BR2_PACKAGE_LIBNL
	select BR2_PACKAGE_LIBCURL
	help
	  wifi-private: wifiserver & wificlient
```

## source/vendor/autochips/proprietary/build/configs/package/connectivity/wifi/wifi-public/Config.in
```kconfig
config BR2_PACKAGE_WIFI_PUBLIC
	bool "wifi-public"
	select BR2_PACKAGE_WIFI_PRIVATE
	help
	  wifi-public: wifiserver config & wificlient api
```

## source/vendor/autochips/proprietary/build/configs/package/connectivity/wifi/wifi/Config.in
```kconfig
menuconfig BR2_PACKAGE_WIFI
	bool "wifi package group"
	select BR2_PACKAGE_WIFI_PUBLIC
	select BR2_PACKAGE_WIFI_PRIVATE
	select BR2_PACKAGE_DBUS_CPP
	select BR2_PACKAGE_CONNMAN
	select BR2_PACKAGE_WPA_SUPPLICANT
	select BR2_PACKAGE_ATC_COMBO
	select BR2_PACKAGE_AIC8800
	select BR2_PACKAGE_IPERF3
	help
	  wifi package group

if BR2_PACKAGE_WIFI
	source "$BR2_EXTERNAL_AC8X_PATH/package/connectivity/wifi/wifi-public/Config.in"
	source "$BR2_EXTERNAL_AC8X_PATH/package/connectivity/wifi/wifi-private/Config.in"
	source "$BR2_EXTERNAL_AC8X_PATH/package/connectivity/wifi/dbus-cpp/Config.in"
	source "$BR2_EXTERNAL_AC8X_PATH/package/connectivity/wifi/connman/Config.in"
	source "$BR2_EXTERNAL_AC8X_PATH/package/connectivity/wifi/wpa_supplicant/Config.in"
	source "$BR2_EXTERNAL_AC8X_PATH/package/connectivity/wifi/atc_combo/Config.in"
	source "$BR2_EXTERNAL_AC8X_PATH/package/connectivity/wifi/aic8800/Config.in"
endif
```

## source/vendor/autochips/proprietary/build/configs/package/connectivity/wifi/wpa_supplicant/Config.in
```kconfig
config BR2_PACKAGE_WPA_SUPPLICANT
	bool "wpa_supplicant"
	select BR2_PACKAGE_DBUS
	select BR2_PACKAGE_LIBNL
	select BR2_PACKAGE_OPENSSL
	help
	  wpa_supplicant
```
