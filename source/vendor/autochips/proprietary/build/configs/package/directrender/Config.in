## source/vendor/autochips/proprietary/build/configs/package/directrender/Config.in
```kconfig
config BR2_PACKAGE_DIRECTRENDER
	bool "directrender"
	help
	  Autochips directrender.
```

## source/vendor/autochips/proprietary/build/configs/package/displayctrl/Config.in
```kconfig
config BR2_PACKAGE_DISPLAYCTRL
	bool "displayctrl"
	help
	  this is a display backlight test
```

## source/vendor/autochips/proprietary/build/configs/package/fast-display-test/Config.in
```kconfig
config BR2_PACKAGE_FAST_DISPLAY_TEST
	bool "Fastdisplay_test"
	help
		this is fast displaiy test
```

## source/vendor/autochips/proprietary/build/configs/package/fsck_msdos/Config.in
```kconfig
config BR2_PACKAGE_FSCK_MSDOS
	bool "fsck msdos binary"
	help
	  Autochips fsck msdos binary
```

## source/vendor/autochips/proprietary/build/configs/package/libatccrypto/Config.in
```kconfig
config BR2_PACKAGE_LIBATCCRYPTO
	bool "libatccrypto"
	help
	  this is a libatccrypto so
```

## source/vendor/autochips/proprietary/build/configs/package/libatcsurface/Config.in
```kconfig
config BR2_PACKAGE_LIBATCSURFACE
	bool "libsurface_atc"
	help
	  this is a libsurface_atc
```

## source/vendor/autochips/proprietary/build/configs/package/libavm/Config.in
```kconfig
config BR2_PACKAGE_LIBAVM
	bool "libavm so"
	select BR2_PACKAGE_OPENCV3
	help
	  this is a avm algo so
```

## source/vendor/autochips/proprietary/build/configs/package/libdinfox/Config.in
```kconfig
config BR2_PACKAGE_LIBDINFOX
	bool "libdinfo.so for en/decrypt"
	help
	  libdinfo.so for en/decrypt
```

## source/vendor/autochips/proprietary/build/configs/package/libdisplaysetting/Config.in
```kconfig
config BR2_PACKAGE_LIBDISPLAYSETTING
	bool "libdisplaysetting"
	help
	  this is a libdisplaysetting
```

## source/vendor/autochips/proprietary/build/configs/package/libdvr/Config.in
```kconfig
config BR2_PACKAGE_LIBDVR
	depends on BR2_PACKAGE_ATCMULTIMEDIA
	depends on BR2_PACKAGE_ATCMEDIASCANNER
	depends on BR2_PACKAGE_ATCCODEC
	depends on BR2_PACKAGE_MMISC
	depends on BR2_PACKAGE_LIBATCSURFACE
	depends on BR2_PACKAGE_ATCMEDIAPLAYER

	bool "libdvr so"
	help
	this is a dvr so
```

## source/vendor/autochips/proprietary/build/configs/package/libfastdisplay/Config.in
```kconfig
config BR2_PACKAGE_LIBFASTDISPLAY
	bool "libfastdisplay"
	help
	  this is a libfastdisplay
```

## source/vendor/autochips/proprietary/build/configs/package/libidcclientmanager/Config.in
```kconfig
config BR2_PACKAGE_LIBIDCCLIENTMANAGER
	bool "libidcclientmanager"
	help
		this is a libidcclientmanager
```

## source/vendor/autochips/proprietary/build/configs/package/libmetazone/Config.in
```kconfig
config BR2_PACKAGE_LIBMETAZONE
	bool "libmetazone"
	help
	  Autochips libmetazone.
```

## source/vendor/autochips/proprietary/build/configs/package/libsettings_atc/Config.in
```kconfig
config BR2_PACKAGE_LIBSETTINGS_ATC
	bool "libsettings_atc"
	help
	  this is a libsettings_atc
```

## source/vendor/autochips/proprietary/build/configs/package/libupdate/Config.in
```kconfig
config BR2_PACKAGE_LIBUPDATE
	bool "update library"
	help
	  Autochips update library
```
