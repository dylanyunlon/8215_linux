## source/vendor/autochips/proprietary/build/configs/package/mali-t400/Config.in
```kconfig
config BR2_PACKAGE_MALI_T400
	bool "mali-t400"
	select BR2_PACKAGE_HAS_LIBEGL
	select BR2_PACKAGE_HAS_LIBGLES
	help
	  this is a mali-t400

if BR2_PACKAGE_MALI_T400

config BR2_PACKAGE_PROVIDES_LIBEGL
	default "mali-t400"

config BR2_PACKAGE_PROVIDES_LIBGLES
	default "mali-t400"

endif
```

## source/vendor/autochips/proprietary/build/configs/package/mali-t82x/Config.in
```kconfig
config BR2_PACKAGE_MALI_T82X
	bool "mali-t82x"
	select BR2_PACKAGE_HAS_LIBEGL
	select BR2_PACKAGE_HAS_LIBGLES
	help
	  Install the binary user-space components for the ARM Mali
	  Midgard T82X GPU. This package requires a kernel with the
	  ARM Mali Midgard GPU Kernel Drivers enabled.

if BR2_PACKAGE_MALI_T82X

config BR2_PACKAGE_PROVIDES_LIBEGL
	default "mali-t82x"

config BR2_PACKAGE_PROVIDES_LIBGLES
	default "mali-t82x"

endif
```

## source/vendor/autochips/proprietary/build/configs/package/mali_v61/Config.in
```kconfig
config BR2_PACKAGE_MALI_V61
	bool "mali_v61"
	select BR2_PACKAGE_HAS_LIBOPENMAX
	help
	  Autochips mali v61 contains the omx library to use
          the Video Codec driver.

if BR2_PACKAGE_MALI_V61

config BR2_PACKAGE_PROVIDES_LIBOPENMAX
        default "mali_v61"

endif
```

## source/vendor/autochips/proprietary/build/configs/package/mountservice/Config.in
```kconfig
config BR2_PACKAGE_MOUNTSERVICE
	bool "mountservice binary"
	help
	  Autochips mountservice binary
```

## source/vendor/autochips/proprietary/build/configs/package/policyaux/Config.in
```kconfig
config BR2_PACKAGE_POLICYAUX
	bool "policyaux"
	select BR2_PACKAGE_DBUS
	help
	  Autochips audio policyaux.
```

## source/vendor/autochips/proprietary/build/configs/package/qd-cluster-app/Config.in
```kconfig
config BR2_PACKAGE_QD_CLUSTER_APP
	bool "qd-cluster-app"
	help
	  this is a qd cluster-app
```

## source/vendor/autochips/proprietary/build/configs/package/screen_frozen/Config.in
```kconfig
config BR2_PACKAGE_SCREEN_FROZEN
	bool "screen frozen config"
	help
	  this is screen frozen configuration application.
```

## source/vendor/autochips/proprietary/build/configs/package/singlepanel-app/Config.in
```kconfig
config BR2_PACKAGE_SINGLEPANEL_APP
	bool "singlepanel-app"
	select BR2_PACKAGE_QT5BASE
	select BR2_PACKAGE_QT5BASE_GUI
	help
	  this is a qt singlepanel-app
```

## source/vendor/autochips/proprietary/build/configs/package/storage_utils/Config.in
```kconfig
config BR2_PACKAGE_STORAGE_UTILS
	bool "storage_utils library"
	help
	  Autochips storage_utils library
```

## source/vendor/autochips/proprietary/build/configs/package/stressapptest/Config.in
```kconfig
config BR2_PACKAGE_STRESSAPPTEST
	bool "memory stress test"
	help
	  memory stress test tool
```

## source/vendor/autochips/proprietary/build/configs/package/universal_utils/Config.in
```kconfig
config BR2_PACKAGE_UNIVERSAL_UTILS
	bool "universal_utils"
	help
	  this is a universal_utils
```

## source/vendor/autochips/proprietary/build/configs/package/update/Config.in
```kconfig
config BR2_PACKAGE_UPDATE
	bool "update feature"
	help
	  Autochips update feature.
```

## source/vendor/autochips/proprietary/build/configs/package/videoin_common/Config.in
```kconfig
config BR2_PACKAGE_VIDEOIN_COMMON
	bool "libvideoin_common"
	help
	  this is a videoin common so
```
