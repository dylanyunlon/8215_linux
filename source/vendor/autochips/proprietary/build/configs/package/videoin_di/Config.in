## source/vendor/autochips/proprietary/build/configs/package/videoin_di/Config.in
```kconfig
config BR2_PACKAGE_VIDEOIN_DI
	bool "libvideoin_di"
	help
	  this is a videoin di so
```

## source/vendor/autochips/proprietary/build/configs/package/videoin_preview/Config.in
```kconfig
config BR2_PACKAGE_VIDEOIN_PREVIEW
	bool "libvideoin_preview"
	depends on BR2_PACKAGE_BUF_ALLOCATOR
	help
	  this is a videoin preview so
```

## source/vendor/autochips/proprietary/build/configs/package/videoin_service/Config.in
```kconfig
config BR2_PACKAGE_VIDEOIN_SERVICE
	bool "videoin_service"
	depends on BR2_PACKAGE_VIDEOIN_PREVIEW
	help
	  this is a videoin service
```

## source/vendor/autochips/proprietary/build/configs/package/videoin_setting/Config.in
```kconfig
config BR2_PACKAGE_VIDEOIN_SETTING
	bool "libvideoin_setting"
	help
	  this is a videoin setting so
```

## source/vendor/autochips/proprietary/build/configs/package/videoin_v4l2/Config.in
```kconfig
config BR2_PACKAGE_VIDEOIN_V4L2
	bool "libvideoin_v4l2"
	help
	  this is a videoin v4l2 so
```

## source/vendor/autochips/proprietary/build/configs/package/vip_service/Config.in
```kconfig
config BR2_PACKAGE_VIP_SERVICE
	bool "vip_service"
	depends on BR2_PACKAGE_BUF_ALLOCATOR
	help
	  this is a vip service
```
